## config/boards/shields/zuuz/Kconfig.defconfig
```kconfig
# Copyright (c) 2020 The ZMK Contributors
# SPDX-License-Identifier: MIT

if SHIELD_ZUUZ_LEFT

config ZMK_KEYBOARD_NAME
    default "Zuuz"

config ZMK_SPLIT_ROLE_CENTRAL
    default y

endif

if SHIELD_ZUUZ_LEFT || SHIELD_ZUUZ_RIGHT

config ZMK_SPLIT
    default y

endif
```

## config/boards/shields/zuuz/Kconfig.shield
```kconfig
# Copyright (c) 2020 The ZMK Contributors
# SPDX-License-Identifier: MIT

config SHIELD_ZUUZ_LEFT
    def_bool $(shields_list_contains,zuuz_left)

config SHIELD_ZUUZ_RIGHT
    def_bool $(shields_list_contains,zuuz_right)
```

## config/west.yml
```yaml
manifest:
  remotes:
    - name: petejohanson
      url-base: https://github.com/petejohanson
    - name: claybford
      url-base: https://github.com/claybford
  projects:
    - name: zmk
      remote: claybford #petejohanson
      revision: feat/pointers-move-scroll
      import: app/west.yml
    - name: cirque-input-module
      remote: petejohanson
      revision: main
  self:
    path: config
```
